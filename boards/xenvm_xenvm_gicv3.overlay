/*
 * Copyright (c) 2026 TOKITA Hiroshi
 *
 * SPDX-License-Identifier: Apache-2.0
 */

/ {
	virtio_mmio0: virtio@2000000 {
		compatible = "virtio,mmio";
		reg = <0x0 0x02000000 0x0 0x200>;
		interrupts = <GIC_SPI 1 IRQ_TYPE_EDGE IRQ_DEFAULT_PRIORITY>;
		interrupt-parent = <&gic>;
		status = "okay";

		/*
		 * Domain id of the grant-based backend (the driver domain running
		 * the Xen vhost-blk sample with grant_usage=1). It MUST match the
		 * backend domain's actual domid, otherwise the frontend grants its
		 * pages to the wrong domain and the backend cannot map them. Adjust
		 * this to the driver domain's domid for your deployment.
		 */
		xen,backend-domid = <1>;

		virtio_blk: virtio-blk {
			compatible = "virtio,blk";
			disk-name = "VIRTIOBLK0";
			status = "okay";
		};
	};
};
